## kernel/2.6.29/arch/arm/plat-s3c64xx/Kconfig
```kconfig
# arch/arm/plat-s3c64xx/Kconfig
#
# Copyright 2008 Openmoko, Inc.
# Copyright 2008 Simtec Electronics
#	Ben Dooks <ben@simtec.co.uk>
#
# Licensed under GPLv2

config PLAT_S3C64XX
	bool
	depends on ARCH_S3C64XX
	select PLAT_S3C
	select ARM_VIC
	default y
	select NO_IOPORT
	select ARCH_REQUIRE_GPIOLIB
	select S3C_GPIO_TRACK
	select S3C_GPIO_PULL_UPDOWN
	select S3C_GPIO_CFG_S3C24XX
	select S3C_GPIO_CFG_S3C64XX
	help
	  Base platform code for any Samsung S3C64XX device

if PLAT_S3C64XX

# Configuration options shared by all S3C64XX implementations

config CPU_S3C64XX_INIT
	bool
	help
	  Common initialisation code for the S3C6400 that is shared
	  by other CPUs in the series, such as the S3C6410.

config CPU_S3C64XX_CLOCK
	bool
	help
	  Common clock support code for the S3C6400 that is shared
	  by other CPUs in the series, such as the S3C6410.

# platform specific device setup

config S3C64XX_SETUP_I2C0
	bool
	default y
	help
	  Common setup code for i2c bus 0.

	  Note, currently since i2c0 is always compiled, this setup helper
	  is always compiled with it.

config S3C64XX_SETUP_I2C1
	bool
	help
	  Common setup code for i2c bus 1.

config S3C64XX_ADC
	bool "S3C64XX ADC D/D support"
	help
	 Analog to Digital conversion(ADC) D/D for S3C64XX support   

config S3C64XX_DEV_FIMC0
	bool
	default n
	help
	  Compile in platform device definitions for FIMC controller 0

config S3C64XX_DEV_FIMC1
	bool
	default n
	help
	  Compile in platform device definitions for FIMC controller 1

config S3C64XX_SETUP_FIMC0
	bool
	default n
	help
	  Common setup code for FIMC controller 0

config S3C64XX_SETUP_FIMC1
	bool
	default n
	help
	  Common setup code for FIMC controller 1

# FB part
config S3C64XX_DEV_FB
	bool
	depends on FB_S3C_V2
	default n
	help
	  Compile in platform device definitions for FIMD controller

config S3C64XX_SETUP_FB
	bool
	depends on FB_S3C_V2
	default n
	help
	  Common setup code for FIMD controller.

config S3C64XX_DEV_RP
	bool
	default n
	help
	  Compile in platform device definitions for Renderer pipeline

endif

config PWM
	tristate "Pulse Width Modulation (PWM) Timer support"

config S3C6410_PWM
         bool "S3C6410/30 PWM support"
         depends on CPU_S3C6410 && PWM
         help
           S3C6410 PWM support.

config S3C64XX_DOMAIN_GATING
	bool "Support S3C64XX Domain Gating"
	depends on PM
	default n
	help
	  domain power enable / disble when each domain is not active / idle

config S3C64XX_DOMAIN_GATING_DEBUG
	bool "Support S3C64XX Domain Gating Debug"
	depends on S3C64XX_DOMAIN_GATING
	default n
	help
	  s3c64xx domain gating debug message enable / disable
```

## kernel/2.6.29/drivers/media/video/samsung/Kconfig
```kconfig
config VIDEO_SAMSUNG
	bool "Samsung Multimedia Devices"
	default y
	---help---
	  This is a configuration for Samsung multimedia devices.

source "drivers/media/video/samsung/g2d/Kconfig"
source "drivers/media/video/samsung/g3d/Kconfig"
source "drivers/media/video/samsung/jpeg/Kconfig"
source "drivers/media/video/samsung/mfc/Kconfig"
source "drivers/media/video/samsung/pp/Kconfig"
source "drivers/media/video/samsung/tvout/Kconfig"
source "drivers/media/video/samsung/rotator/Kconfig"
source "drivers/media/video/samsung/camera/Kconfig"
source "drivers/media/video/samsung/fimc/Kconfig"
source "drivers/media/video/samsung/cmm/Kconfig"
```

## kernel/2.6.29/drivers/media/video/samsung/camera/Kconfig
```kconfig
config VIDEO_CAM
	bool "S3C6410 CAMERA support"
	depends on VIDEO_SAMSUNG
	default n
	select VIDEO_SAMSUNG_S5K4BA

config VIDEO_SAMSUNG_S5K4BA
	bool
	depends on VIDEO_CAM
	default y
	---help---
	  TBA
```

## kernel/2.6.29/drivers/media/video/samsung/cmm/Kconfig
```kconfig
#
# Makefile for CMM device driver designed by Samsung Electronics 2007
#

config VIDEO_CMM
	bool "S3C6410 CMM device support"
	depends on VIDEO_SAMSUNG
```

## kernel/2.6.29/drivers/media/video/samsung/fimc/Kconfig
```kconfig
#
# Makefile for CMM device driver designed by Samsung Electronics 2007
#

config VIDEO_FIMC
	bool "S3C6410 FIMC(Camera Interface) device support"
	depends on VIDEO_SAMSUNG && VIDEO_CAPTURE_DRIVERS && VIDEO_V4L2
	select VIDEO_FIXED_MINOR_RANGES
	default n
	---help---
	  This is a video4linux driver for Samsung FIMC device.

config VIDEO_FIMC_DEBUG
	bool "FIMC driver debug messages"
	depends on VIDEO_FIMC

source "drivers/media/video/samsung/fimc/Kconfig-camera"

config VIDEO_FIMC_CAM_CH
	int "External Camera channel (0=A, 1=B)"
	depends on VIDEO_FIMC
	default "0"

config VIDEO_FIMC_CAM_RESET
	int "Reset Type (0=low, 1=high)"
	depends on VIDEO_FIMC
	default "0"
```

## kernel/2.6.29/drivers/media/video/samsung/g2d/Kconfig
```kconfig
#
# Makefile for 2D device driver designed by Samsung Electronics 2007
#

config VIDEO_G2D
	bool "S3C6410 2D Graphic device support"
	depends on VIDEO_SAMSUNG
```

## kernel/2.6.29/drivers/media/video/samsung/g3d/Kconfig
```kconfig
#
# Makefile for 3D device driver designed by Samsung Electronics 2007
#

config VIDEO_G3D
	bool "S3C6410 3D Graphic device support"
	depends on VIDEO_SAMSUNG
	help
		FIMG-3D
```

## kernel/2.6.29/drivers/media/video/samsung/jpeg/Kconfig
```kconfig
#
# Makefile for JPEG CODEC device driver designed by Samsung Electronics 2007
#

config VIDEO_JPEG
	bool "S3C6410 Jpeg device support"
	depends on VIDEO_SAMSUNG
```

## kernel/2.6.29/drivers/media/video/samsung/mfc/Kconfig
```kconfig
#
# Makefile for MFC device driver designed by Samsung Electronics 2007
#

config VIDEO_MFC
	bool "S3C6410 MFC device support"
	depends on VIDEO_SAMSUNG
```

## kernel/2.6.29/drivers/media/video/samsung/pp/Kconfig
```kconfig
#
# Makefile for PostProcessor device driver designed by Samsung Electronics 2007
#

config VIDEO_PP
	bool "S3C6410 PP(post process) device support"
	depends on VIDEO_SAMSUNG
```

## kernel/2.6.29/drivers/media/video/samsung/rotator/Kconfig
```kconfig
#
# Makefile for rotator device driver designed by Samsung Electronics 2007
#

config VIDEO_ROTATOR
	bool "S3C6410 Rotator device support"
	depends on VIDEO_SAMSUNG
```

## kernel/2.6.29/drivers/media/video/samsung/tvout/Kconfig
```kconfig
#
# Makefile for TVout device driver designed by Samsung Electronics 2007
#

config VIDEO_TVOUT
        bool "S3C6410 TV-out device support"
        depends on (VIDEO_DEV=y) && VIDEO_SAMSUNG
        default y if VIDEO_DEV
```

## kernel/2.6.29/sound/soc/s3c64xx/Kconfig
```kconfig
menu "SoC Audio for the Samsung S3C"
	depends on ARCH_S3C64XX || ARCH_S5P64XX

config SND_S3C64XX_SOC
	tristate "SoC Audio for the Samsung S3C chips"
	depends on ARCH_S3C64XX
	default y
	select SND_PCM
	help
	  Say Y or M if you want to add support for codecs attached to
	  the S3C AC97, I2S or SSP interface. You will also need
	  to select the audio interfaces to support below.

config SND_S5P64XX_SOC
	tristate "SoC Audio for the Samsung S5P chips"
	depends on ARCH_S5P64XX
	select SND_PCM
	help
	  Say Y or M if you want to add support for codecs attached to
	  the S3C AC97, I2S or SSP interface. You will also need
	  to select the audio interfaces to support below.

choice
       prompt "S3C64XX I2S BUS Select"
	depends on SND_S3C64XX_SOC

config SND_S3C64XX_I2S_BUS0
	bool "Audio Codec at I2S bus0(GPDx)"
	depends on SND_S3C64XX_SOC
	help
	  Say Y here to make I2S bus0 as audio codec bus port.

config SND_S3C64XX_I2S_BUS1
	bool "Audio Codec at I2S bus1(GPEx)"
	depends on SND_S3C64XX_SOC
	help
	  Say Y here to make I2S bus1 as audio codec bus port.
endchoice

config SND_S3C_I2S_V32
	tristate

config SND_S3C_I2S_V40
	tristate

config SND_S3C_I2S_V50
	tristate

config SND_S3C_AC97
	tristate

config SND_S3C64XX_SOC_SMDK6410_WM9713
	tristate "SoC AC97 Audio support for SMDK6410 - WM9713"
	depends on SND_S3C64XX_SOC && (MACH_SMDK6410)
	select SND_S3C_AC97
	select SND_SOC_WM9713
	help
	  Say Y if you want to add support for SoC audio on smdk6410
	  with the WM9713.

choice
        prompt "SMDK Record Path Select"
	depends on SND_S3C64XX_SOC_SMDK6400_WM9713 || SND_S3C64XX_SOC_SMDK6410_WM9713

config SOUND_WM9713_INPUT_STREAM_LINE
	bool "Input Stream is LINE-IN"
	depends on SND_S3C64XX_SOC_SMDK6400_WM9713 || SND_S3C64XX_SOC_SMDK6410_WM9713
	help
	  Say Y here to make input stream as LINE-IN.

config SOUND_WM9713_INPUT_STREAM_MIC
	bool "Input Stream is MIC"
	depends on SND_S3C64XX_SOC_SMDK6400_WM9713 || SND_S3C64XX_SOC_SMDK6410_WM9713
	help
	  Say Y here to make input stream as MIC.
endchoice


config SND_S3C64XX_SOC_SMDK6410_WM8580
	tristate "SoC I2S Audio support for SMDK6410 - WM8580"
	depends on SND_S3C64XX_SOC && (MACH_SMDK6410 || MACH_SMDK6430)
	default y
	select SND_S3C_I2S_V40
	select SND_SOC_WM8580
	help
	  Say Y if you want to add support for SoC audio on smdk6410
	  with the WM8580.

choice
        prompt "SMDK Record Path Select"
	depends on SND_S3C64XX_SOC_SMDK6410_WM8580 || SND_S3C24XX_SOC_SMDK2450_WM8580

config SOUND_WM8580_INPUT_STREAM_LINE
	bool "Input Stream is LINE-IN"
	depends on SND_S3C64XX_SOC_SMDK6410_WM8580 || SND_S3C24XX_SOC_SMDK2450_WM8580
	help
	  Say Y here to make input stream as LINE-IN.

config SOUND_WM8580_INPUT_STREAM_MIC
	bool "Input Stream is MIC"
	depends on SND_S3C64XX_SOC_SMDK6410_WM8580 || SND_S3C24XX_SOC_SMDK2450_WM8580
	help
	  Say Y here to make input stream as MIC.
endchoice

config SND_S5P64XX_SOC_SMDK6440_WM8580
	tristate "SoC I2S Audio support for SMDK6440 - WM8580"
	depends on SND_S5P64XX_SOC && MACH_SMDK6440
	select SND_S3C_I2S_V40
	select SND_SOC_WM8580
	help
	  Say Y if you want to add support for SoC audio on smdk6440
	  with the WM8580.

choice
        prompt "SMDK Record Path Select"
	depends on SND_S5P64XX_SOC_SMDK6440_WM8580

config SOUND_SMDK6440_WM8580_INPUT_STREAM_LINE
	bool "Input Stream is LINE-IN"
	depends on SND_S5P64XX_SOC_SMDK6440_WM8580
	help
	  Say Y here to make input stream as LINE-IN.

config SOUND_SMDK6440_WM8580_INPUT_STREAM_MIC
	bool "Input Stream is MIC"
	depends on SND_S5P64XX_SOC_SMDK6440_WM8580
	help
	  Say Y here to make input stream as MIC.
endchoice

config SND_S3C64XX_SOC_SMDK6410_WM8753
	tristate "SoC I2S Audio support for SMDK6410 - WM8753"
	depends on SND_S3C64XX_SOC && (MACH_SMDK6410 || MACH_SMDK6430)
	select SND_S3C_I2S_V32
	select SND_SOC_WM8753
	default y
	help
	  Say Y if you want to add support for SoC audio on smdk6410
	  with the WM8753.

choice
        prompt "WM8753 Clock Mode Select"
	depends on SND_S3C64XX_SOC_SMDK6410_WM8753

config SND_S3C64XX_SOC_SMDK6410_WM8753_MASTER
	bool "Audio Codec WM8753 in Master Mode"
	depends on SND_S3C64XX_SOC_SMDK6410_WM8753
	help
	  Say Y here to make wm8753 as master mode.

config SND_S3C64XX_SOC_SMDK6410_WM8753_SLAVE
	bool "Audio Codec WM8753 in Slave Mode"
	depends on SND_S3C64XX_SOC_SMDK6410_WM8753
	help
	  Say Y here to make wm8753 as slave mode.
endchoice
	
config SND_S3C64XX_SOC_SMDK6410_WM8990
	tristate "SoC I2S Audio support for SMDK6410 - WM8990"
	depends on SND_S3C64XX_SOC && (MACH_SMDK6410)
	select SND_S3C_I2S_V32
	select SND_SOC_WM8990
	help
	  Say Y if you want to add support for SoC audio on smdk6410
	  with the WM8990.

choice
        prompt "SMDK Record Path Select"
	depends on SND_S3C64XX_SOC_SMDK6410_WM8990 || SND_S3C64XX_SOC_SMDK6400_WM8990

config SOUND_WM8990_INPUT_STREAM_LINE_IN
	bool "Input Stream is LINE-IN"
	depends on SND_S3C64XX_SOC_SMDK6410_WM8990 || SND_S3C64XX_SOC_SMDK6400_WM8990
	help
	  Say Y here to make input stream as LINE-IN.

config SOUND_WM8990_INPUT_STREAM_MIC_IN
	bool "Input Stream is MIC"
	depends on SND_S3C64XX_SOC_SMDK6410_WM8990 || SND_S3C64XX_SOC_SMDK6400_WM8990
	help
	  Say Y here to make input stream as MIC.
endchoice


config SND_S3C64XX_SOC_SMDK6410_WM8993
	tristate "SoC I2S Audio support for SMDK6410 - WM8993"
	depends on SND_S3C64XX_SOC && (MACH_SMDK6410)
	select SND_S3C_I2S_V32
	select SND_SOC_WM8993
	help
	  Say Y if you want to add support for SoC audio on smdk6410
	  with the WM8993.

choice
        prompt "SMDK Record Path Select"
	depends on SND_S3C64XX_SOC_SMDK6410_WM8993 || SND_S3C64XX_SOC_SMDK6400_WM8993

config SOUND_WM8993_INPUT_STREAM_LINE_IN
	bool "Input Stream is LINE-IN"
	depends on SND_S3C64XX_SOC_SMDK6410_WM8993 || SND_S3C64XX_SOC_SMDK6400_WM8993
	help
	  Say Y here to make input stream as LINE-IN.

config SOUND_WM8993_INPUT_STREAM_MIC_IN
	bool "Input Stream is MIC"
	depends on SND_S3C64XX_SOC_SMDK6410_WM8993 || SND_S3C64XX_SOC_SMDK6400_WM8993
	help
	  Say Y here to make input stream as MIC.
endchoice


config SND_S3C64XX_SOC_SMDK6410_S5M8751
	tristate "SoC I2S Audio support for SMDK6410 - S5M8751"
	depends on SND_S3C64XX_SOC && (MACH_SMDK6410)
	select SND_S3C_I2S_V32
	select SND_SOC_S5M8751
	help
	  Say Y if you want to add support for SoC audio on smdk6410
	  with the S5M8751.

config SND_S3C64XX_SOC_MEIZUM8_WM8753
	tristate "SoC I2S Audio support for MEIZUM8 - WM8753"
	depends on SND_S3C64XX_SOC && (MACH_SMDK6410 || MACH_SMDK6430)
	default y
	select SND_S3C_I2S_V32
	select SND_SOC_WM8753
	help
	  Say Y if you want to add support for SoC audio on meizu m8 smartphone
	  with the WM8753.

endmenu
```
